## boards/shields/ec-charly/Kconfig.defconfig
```kconfig
if SHIELD_ECCHARLY_R

config ZMK_KEYBOARD_NAME
    default "ec-charly"

config ZMK_SPLIT_ROLE_CENTRAL
    default y

endif

if SHIELD_ECCHARLY_L || SHIELD_ECCHARLY_R

config ZMK_SPLIT
    default y

endif

if SHIELD_ECCHARLY_R

# Other settings

config ZMK_POINTING
    default y

# Assuming pointing device uses SPI
config SPI
    default y

endif
```

## boards/shields/ec-charly/Kconfig.shield
```kconfig
config SHIELD_ECCHARLY_R
    def_bool $(shields_list_contains,ec-charly_r)

config SHIELD_ECCHARLY_L
    def_bool $(shields_list_contains,ec-charly_l)
```

## config/west.yml
```yaml
manifest:
  remotes:
    - name: zmkfirmware
      url-base: https://github.com/zmkfirmware
    - name: KATATHY-ZMK
      url-base: https://github.com/KATACY-ZMK
    - name: zmkfirmware
      url-base: https://github.com/zmkfirmware
    - name: prospector
      url-base: https://github.com/t-ogura

  projects:
    - name: zmk
      remote: zmkfirmware
      revision: main
      import: app/west.yml
    - name: zmk
      remote: zmkfirmware
      revision: main
      import: app/west.yml
    - name: prospector-zmk-module
      remote: prospector
      revision: v2.1.0  # ZMK ≤0.3 (Zephyr 3.x) の場合は v2.0.0 を使用
      path: modules/prospector-zmk-module

  self:
    path: config
```
